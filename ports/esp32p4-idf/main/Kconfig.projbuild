## ports/esp32s3-idf/main/Kconfig.projbuild
```kconfig
menu "JellyFrame ESP32-S3 benchmark"

choice JELLYFRAME_ESP32S3_RUN_MODE
    prompt "Startup run mode"
    default JELLYFRAME_ESP32S3_RUN_BENCHMARK
    help
        Select whether app_main runs the one-shot benchmark/smoke path or
        starts the reusable JellyFrame UI task skeleton.

config JELLYFRAME_ESP32S3_RUN_BENCHMARK
    bool "Run benchmark and smoke validations"

config JELLYFRAME_ESP32S3_RUN_TIMER_UI_TASK
    bool "Start Timer UI task"
    help
        Starts a FreeRTOS UI task that loads /timer.html from the resource
        bundle, dispatches bounded board input events, updates the timer once
        per second and publishes port telemetry.

config JELLYFRAME_ESP32S3_RUN_JFDP_TRANSPORT_ACCEPTANCE
    bool "Run JFDP/1 USB Serial/JTAG transport acceptance"
    help
        Starts a transport-only JFDP/1 endpoint on the ESP32-S3 native USB
        Serial/JTAG CDC interface. This profile owns that byte stream and must
        not share it with the ESP-IDF console. It uses only bounded in-memory
        staging and never publishes an App registry entry.

config JELLYFRAME_ESP32S3_RUN_DEVICE_IMAGE_LIFECYCLE_ACCEPTANCE
    bool "Run Developer Image persistent lifecycle acceptance"
    help
        Starts the JFDP/1 endpoint backed by the raw `storage` partition.
        Staging is verified as JFAPPV0 before a redundant registry record
        atomically publishes it. This profile owns native USB Serial/JTAG and
        must not share that byte stream with the ESP-IDF console.

config JELLYFRAME_ESP32S3_DEVICE_IMAGE_TEST_FAULT_POINT
    int "Developer Image acceptance fault point"
    depends on JELLYFRAME_ESP32S3_RUN_DEVICE_IMAGE_LIFECYCLE_ACCEPTANCE
    range 0 8
    default 0
    help
        Test-only persistent lifecycle interruption selector. Zero is normal;
        nonzero values reset after begin, first/last chunk, verification or
        registry publication, corrupt both registry records on boot, or reject
        registry publication. It is never enabled by a product profile.

config JELLYFRAME_ESP32S3_RUN_BAND_SHELL_UI_TASK
    bool "Start 172x320 Band System Shell UI task"
    help
        Starts a static, host-owned wearable system-shell fixture from
        /band_shell.html. Board input changes among watch face, launcher,
        activity, weather, quick settings and notification views without
        enabling JerryScript. It is a visual and input bring-up fixture, not a
        product launcher or permission implementation.

config JELLYFRAME_ESP32S3_RUN_FORMS_ADVANCED_ACCEPTANCE
    bool "Run forms.advanced acceptance fixture"
    help
        Starts the port-owned static forms fixture and bounded native input
        replay. It does not claim JerryScript or FormData device coverage.

config JELLYFRAME_ESP32S3_RUN_GRADIENT_FASTPATH_UI_TASK
    bool "Run opaque linear-gradient presentation fixture"
    help
        Starts a fixed 172x320 opaque linear-gradient workload at 30 Hz. It
        exists only for board A/B evidence of the platform-neutral renderer
        fast path. It has no input, script, animation or product-shell role.

config JELLYFRAME_ESP32S3_RUN_SCROLL_BENCHMARK
    bool "Run retained scroll benchmark"
    help
        Starts a deterministic 30 Hz scrolling list workload. It reuses the
        retained render/layout trees, resolves one overflow:auto container and
        presents only that visible container region. It is a measured board
        workload, not a production scroll-shell implementation.

config JELLYFRAME_ESP32S3_RUN_POWER_ACCEPTANCE
    bool "Run panel screen-off/resume acceptance fixture"
    depends on JELLYFRAME_ESP32S3_BOARD_ENABLE_HARDWARE
    help
        Starts a static Timer page and cycles the selected board panel through
        display sleep, backlight off, wake and full repaint. This validates the
        board-local screen power boundary; it is not a claim of full SoC deep
        sleep or product power management.

config JELLYFRAME_ESP32S3_RUN_SOC_POWER_ACCEPTANCE
    bool "Run ESP32-S3 light/deep sleep acceptance fixture"
    depends on JELLYFRAME_ESP32S3_BOARD_ENABLE_HARDWARE
    help
        Runs a port-only SoC power fixture after a normal board present. It
        cycles light sleep with timer and touch GPIO wake sources, then uses
        RTC-retained state and timer wake for deep-sleep cold-start recovery.
        Current measurement remains an external acceptance step.

config JELLYFRAME_ESP32S3_SOC_POWER_DEEP_SLEEP_ONLY
    bool "Enter deep sleep immediately for current measurement"
    depends on JELLYFRAME_ESP32S3_RUN_SOC_POWER_ACCEPTANCE
    default n
    help
        Disable the light-sleep and timed deep-sleep recovery loops for a
        static current measurement. The board is initialized, its display is
        powered down, peripherals are released, and the SoC remains in deep
        sleep until an external reset.

config JELLYFRAME_ESP32S3_SOC_POWER_MEASURE_ACTIVE
    bool "Hold active display state for external current measurement"
    depends on JELLYFRAME_ESP32S3_RUN_SOC_POWER_ACCEPTANCE
    default n
    help
        Port-only measurement fixture. After a first present, leave the
        display on and keep the board initialized until an external reset.

config JELLYFRAME_ESP32S3_SOC_POWER_MEASURE_SCREEN_OFF
    bool "Hold screen-off idle state for external current measurement"
    depends on JELLYFRAME_ESP32S3_RUN_SOC_POWER_ACCEPTANCE
    default n
    help
        Port-only measurement fixture. Put the panel and backlight into the
        board screen-off state while keeping the SoC and board runtime awake.

config JELLYFRAME_ESP32S3_SOC_POWER_MEASURE_LIGHT_SLEEP
    bool "Hold light-sleep state for external current measurement"
    depends on JELLYFRAME_ESP32S3_RUN_SOC_POWER_ACCEPTANCE
    default n
    help
        Port-only measurement fixture. Turn the screen off and repeatedly
        enter 60-second timer-woken light-sleep segments until reset.

config JELLYFRAME_ESP32S3_RUN_RESOURCE_FAILURE
    bool "Run missing-resource fallback fixture"
    depends on JELLYFRAME_ESP32S3_BOARD_ENABLE_HARDWARE
    help
        Loads a local page with an intentionally missing stylesheet and image
        URL. The page must still paint its inline fallback. This validates
        bounded resource failure behavior, not image decoding.

config JELLYFRAME_ESP32S3_RUN_IMAGE_ACCEPTANCE
    bool "Run bounded BMP image acceptance fixture"
    depends on JELLYFRAME_ESP32S3_BOARD_ENABLE_HARDWARE && JELLYFRAME_ESP32S3_ENABLE_BMP_IMAGE_ADAPTER
    help
        Loads one bounded 24/32-bit BMP plus missing, corrupt, oversized and
        unsupported image resources. Rebuilds the fixture 30 times to verify
        cache ownership, rejection and inline placeholder fallback.

config JELLYFRAME_ESP32S3_RUN_APP_RUNTIME_RECOVERY_ACCEPTANCE
    bool "Run native AppRuntime recovery preflight"
    depends on JELLYFRAME_ESP32S3_BOARD_ENABLE_HARDWARE
    help
        Presents the native Band System Shell, then exercises a separate
        AppRuntimeHost through bounded runtime-error, budget-exceeded and
        load-failure teardown cycles. This is a port integration preflight for
        app lifecycle cleanup; it does not enable JerryScript and must not be
        recorded as script-watchdog acceptance.

config JELLYFRAME_ESP32S3_RUN_SCRIPT_TASK_VALUE_PROTOCOL_ACCEPTANCE
    bool "Run script-task value protocol preflight"
    depends on JELLYFRAME_ESP32S3_BOARD_ENABLE_HARDWARE
    help
        Starts separate supervisor, script-worker and UI-owner tasks and
        exercises the mainline value-only script-task protocol. This is a
        port acceptance fixture, not a real JerryScript App: frame packets
        are decoded and checked by the UI owner, while JerryScript remains
        optional and no native pointer crosses a task boundary.

config JELLYFRAME_ESP32S3_RUN_SCRIPT_APP_ACCEPTANCE
    bool "Run real JerryScript App acceptance fixture"
    depends on JELLYFRAME_ESP32S3_BOARD_ENABLE_HARDWARE
    help
        Starts the port-owned real JerryScript script-task fixture. This profile
        requires JELLYFRAME_BUILD_SCRIPTING=ON and JELLYFRAME_BUILD_SCRIPT_TASK_RUNTIME=ON
        at CMake configure time and is isolated from native preflight profiles.

config JELLYFRAME_ESP32S3_RUN_SCRIPT_TASK_VALUE_FRAME_V2_ACCEPTANCE
    bool "Run script-task value-frame v2 acceptance fixture"
    depends on JELLYFRAME_ESP32S3_BOARD_ENABLE_HARDWARE
    help
        Starts an experimental real JerryScript worker/UI-task fixture using
        ScriptTaskAppFrame codec v2. The UI task consumes only copied decoded
        values through ScriptTaskFrameRenderer, including bounded rounded
        overflow clips. This does not change the default v1 product profile.

config JELLYFRAME_ESP32S3_RUN_SCRIPT_SERVICE_ECHO_ACCEPTANCE
    bool "Run real JerryScript service echo acceptance fixture"
    depends on JELLYFRAME_ESP32S3_BOARD_ENABLE_HARDWARE
    help
        Starts the real worker-local JerryScript service_echo fixture. A
        port-owned asynchronous provider task receives copied scalar requests
        and returns copied completion values through the supervisor bridge.

config JELLYFRAME_ESP32S3_SCRIPT_SERVICE_ACCEPTANCE_SCENARIO
    int "Script service acceptance scenario"
    depends on JELLYFRAME_ESP32S3_RUN_SCRIPT_SERVICE_ECHO_ACCEPTANCE
    default 0
    range 0 5
    help
        0 runs the 100-completion echo baseline. 1 runs queued cancellation,
        2 runs in-flight cancellation, 3 runs generation-stale teardown, 4
        runs payload-boundary handling, and 5 runs the 30-minute mixed soak
        provider. Each scenario is built and archived independently so
        cancellation evidence cannot be conflated with the successful echo
        path.

config JELLYFRAME_ESP32S3_RUN_SCRIPT_FAULT_RECOVERY_ACCEPTANCE
    bool "Run real JerryScript fault and recovery acceptance fixture"
    depends on JELLYFRAME_ESP32S3_BOARD_ENABLE_HARDWARE
    help
        Starts the real worker-local fault_lab fixture. Controlled script
        failures publish value-only fatal records; the supervisor tears down
        only the target session and launches a normal replacement worker.

config JELLYFRAME_ESP32S3_RUN_SCRIPT_TASK_VALUE_FRAME_V4_ACCEPTANCE
    bool "Run script-task value-frame v4 acceptance fixture"
    depends on JELLYFRAME_ESP32S3_BOARD_ENABLE_HARDWARE
    help
        Runs an isolated V4 transform/source-clip acceptance fixture. This
        profile is acceptance-only and is never selected by Developer Image
        or product defaults.

endchoice

config JELLYFRAME_ESP32S3_SCRIPT_VALUE_FRAME_V2_DIRTY_ACCEPTANCE
    bool "Exercise value-frame v2 rounded dirty redraw"
    depends on JELLYFRAME_ESP32S3_RUN_SCRIPT_TASK_VALUE_FRAME_V2_ACCEPTANCE
    default n
    help
        Keeps the experimental v2 fixture isolated while making its first
        frame full-screen and subsequent frames alternate between a text
        rect and a rect adjacent to a rounded clip corner. This is an
        acceptance-only correctness path, not a product dirty policy.

config JELLYFRAME_ESP32S3_ENABLE_SCRIPT_TASK_RUNTIME
    bool "Link script-task value protocol runtime"
    depends on JELLYFRAME_ESP32S3_BOARD_ENABLE_HARDWARE
    default y if JELLYFRAME_ESP32S3_RUN_DEVICE_IMAGE_LIFECYCLE_ACCEPTANCE
    help
        Adds the platform-independent value protocol sources to the ESP-IDF
        app-runtime component. Developer Images enable it so installed Apps
        declaring runtime.script can execute in an isolated worker. Keep it
        disabled for ordinary firmware so no script-task mailbox, lease
        registry, bridge, or JavaScript engine is linked.

config JELLYFRAME_ESP32S3_INSTALLED_SCRIPT_FRAME_V4_MALFORMED_PROBE
    bool "Inject one malformed v3/v4 installed ScriptTask frame"
    depends on JELLYFRAME_ESP32S3_ENABLE_SCRIPT_TASK_RUNTIME
    default n
    help
        Acceptance-only port probe. After the worker has published a valid
        initial v4 value frame, it posts one payload whose header claims v3
        while retaining the v4 transform source-clip bytes. The UI must reject
        it and later accept a normal v4 frame. This stays off for Developer
        Images outside the dedicated acceptance profile.

config JELLYFRAME_ESP32S3_ENABLE_BMP_IMAGE_ADAPTER
    bool "Enable bounded BMP image adapter"
    default n

    help
        Links the port-owned uncompressed 24/32-bit BMP decoder and image
        callbacks. It accepts at most 96x96 pixels, 32 KiB decoded pixels,
        16 cached URLs and 256-byte URLs. Keep it disabled for ports and Apps
        that do not render images so they do not link the decoder or retain an
        image cache. This does not enable PNG, JPEG, GIF, WebP, audio or video.

config JELLYFRAME_ESP32S3_RUN_FLEX_GRID_ACCEPTANCE
    bool "Run Flex/Grid ON/OFF acceptance fixture"
    default n
    help
        Starts the port-owned flex/grid acceptance page. The fixture covers
        flex order/gap, grid gap/span and @supports. Use separate ON/OFF
        Render Core CMake profiles for the comparison; this is not a product
        application.

config JELLYFRAME_ESP32S3_UI_TASK_STACK_SIZE
    int "UI task stack size"
    depends on JELLYFRAME_ESP32S3_RUN_TIMER_UI_TASK || JELLYFRAME_ESP32S3_RUN_BAND_SHELL_UI_TASK || JELLYFRAME_ESP32S3_RUN_FORMS_ADVANCED_ACCEPTANCE || JELLYFRAME_ESP32S3_RUN_GRADIENT_FASTPATH_UI_TASK || JELLYFRAME_ESP32S3_RUN_SCROLL_BENCHMARK || JELLYFRAME_ESP32S3_RUN_POWER_ACCEPTANCE || JELLYFRAME_ESP32S3_RUN_SOC_POWER_ACCEPTANCE || JELLYFRAME_ESP32S3_RUN_RESOURCE_FAILURE || JELLYFRAME_ESP32S3_RUN_IMAGE_ACCEPTANCE || JELLYFRAME_ESP32S3_RUN_APP_RUNTIME_RECOVERY_ACCEPTANCE || JELLYFRAME_ESP32S3_RUN_DEVICE_IMAGE_LIFECYCLE_ACCEPTANCE || JELLYFRAME_ESP32S3_RUN_SCRIPT_TASK_VALUE_PROTOCOL_ACCEPTANCE || JELLYFRAME_ESP32S3_RUN_SCRIPT_APP_ACCEPTANCE || JELLYFRAME_ESP32S3_RUN_SCRIPT_TASK_VALUE_FRAME_V2_ACCEPTANCE || JELLYFRAME_ESP32S3_RUN_SCRIPT_TASK_VALUE_FRAME_V4_ACCEPTANCE || JELLYFRAME_ESP32S3_RUN_SCRIPT_SERVICE_ECHO_ACCEPTANCE || JELLYFRAME_ESP32S3_RUN_SCRIPT_FAULT_RECOVERY_ACCEPTANCE
    default 32768
    range 8192 65536
    help
        Stack size for the JellyFrame UI task. Bring-up defaults keep this high
        until stack high-water logs are reviewed on real hardware.

config JELLYFRAME_ESP32S3_UI_TASK_PRIORITY
    int "UI task priority"
    depends on JELLYFRAME_ESP32S3_RUN_TIMER_UI_TASK || JELLYFRAME_ESP32S3_RUN_BAND_SHELL_UI_TASK || JELLYFRAME_ESP32S3_RUN_FORMS_ADVANCED_ACCEPTANCE || JELLYFRAME_ESP32S3_RUN_GRADIENT_FASTPATH_UI_TASK || JELLYFRAME_ESP32S3_RUN_SCROLL_BENCHMARK || JELLYFRAME_ESP32S3_RUN_POWER_ACCEPTANCE || JELLYFRAME_ESP32S3_RUN_SOC_POWER_ACCEPTANCE || JELLYFRAME_ESP32S3_RUN_RESOURCE_FAILURE || JELLYFRAME_ESP32S3_RUN_IMAGE_ACCEPTANCE || JELLYFRAME_ESP32S3_RUN_APP_RUNTIME_RECOVERY_ACCEPTANCE || JELLYFRAME_ESP32S3_RUN_DEVICE_IMAGE_LIFECYCLE_ACCEPTANCE || JELLYFRAME_ESP32S3_RUN_SCRIPT_APP_ACCEPTANCE || JELLYFRAME_ESP32S3_RUN_SCRIPT_TASK_VALUE_FRAME_V2_ACCEPTANCE || JELLYFRAME_ESP32S3_RUN_SCRIPT_TASK_VALUE_FRAME_V4_ACCEPTANCE || JELLYFRAME_ESP32S3_RUN_SCRIPT_SERVICE_ECHO_ACCEPTANCE || JELLYFRAME_ESP32S3_RUN_SCRIPT_FAULT_RECOVERY_ACCEPTANCE
    default 5
    range 1 24

config JELLYFRAME_ESP32S3_UI_TASK_TICK_MS
    int "UI task idle tick delay in ms"
    depends on JELLYFRAME_ESP32S3_RUN_TIMER_UI_TASK || JELLYFRAME_ESP32S3_RUN_BAND_SHELL_UI_TASK || JELLYFRAME_ESP32S3_RUN_GRADIENT_FASTPATH_UI_TASK || JELLYFRAME_ESP32S3_RUN_SCROLL_BENCHMARK || JELLYFRAME_ESP32S3_RUN_POWER_ACCEPTANCE || JELLYFRAME_ESP32S3_RUN_SOC_POWER_ACCEPTANCE || JELLYFRAME_ESP32S3_RUN_RESOURCE_FAILURE || JELLYFRAME_ESP32S3_RUN_IMAGE_ACCEPTANCE || JELLYFRAME_ESP32S3_RUN_APP_RUNTIME_RECOVERY_ACCEPTANCE || JELLYFRAME_ESP32S3_RUN_SCRIPT_APP_ACCEPTANCE || JELLYFRAME_ESP32S3_RUN_SCRIPT_TASK_VALUE_FRAME_V2_ACCEPTANCE || JELLYFRAME_ESP32S3_RUN_SCRIPT_TASK_VALUE_FRAME_V4_ACCEPTANCE
    default 20
    range 1 1000

config JELLYFRAME_ESP32S3_SCRIPT_TASK_STACK_SIZE
    int "JerryScript worker task stack size"
    depends on JELLYFRAME_ESP32S3_ENABLE_SCRIPT_TASK_RUNTIME
    default 24576
    range 12288 65536
    help
        Stack for the isolated script worker task. The worker
        owns only value-protocol state and never owns the panel or renderer.

config JELLYFRAME_ESP32S3_PERSISTENT_STYLE_RESOLVER
    bool "Retain StyleResolver for the loaded UI document"
    depends on JELLYFRAME_ESP32S3_RUN_TIMER_UI_TASK || JELLYFRAME_ESP32S3_RUN_BAND_SHELL_UI_TASK || JELLYFRAME_ESP32S3_RUN_GRADIENT_FASTPATH_UI_TASK || JELLYFRAME_ESP32S3_RUN_SCROLL_BENCHMARK
    default y
    help
        Keeps the stylesheet index and bounded selector-candidate cache across
        retained pipeline rebuilds. Disable only for real-device A/B: the port
        then constructs an equivalent resolver for each rebuild and records
        heap low-water at every rebuild stage, so transient and retained peak
        memory are comparable. This setting is port-only.

config JELLYFRAME_ESP32S3_STYLE_RESOLVER_CACHE_ENTRIES
    int "Persistent StyleResolver candidate-cache entries"
    depends on JELLYFRAME_ESP32S3_RUN_TIMER_UI_TASK || JELLYFRAME_ESP32S3_RUN_BAND_SHELL_UI_TASK || JELLYFRAME_ESP32S3_RUN_GRADIENT_FASTPATH_UI_TASK || JELLYFRAME_ESP32S3_RUN_SCROLL_BENCHMARK
    default 32
    range 0 128
    help
        Bounds the port-owned selector candidate cache retained for one loaded
        UI document. The cache reduces repeated style matching during retained
        pipeline rebuilds, but its entries consume internal heap. Keep this
        deliberately small unless real-device telemetry demonstrates that a
        larger value improves route latency without violating the board's
        internal-RAM low-water target. This does not change Render Core's
        default resolver policy or affect ports that do not create this UI task.
        A value of zero disables retained candidate entries for A/B controls.

config JELLYFRAME_ESP32S3_BAND_SHELL_AUTOROUTE
    bool "Run 30-transition Band Shell acceptance autoroute"
    depends on JELLYFRAME_ESP32S3_RUN_BAND_SHELL_UI_TASK
    default n
    help
        Cycles the static Band Shell through a fixed 30-transition route
        sequence and then stops. This is an unattended retained-pipeline and
        typography acceptance fixture; keep it disabled for interactive use.

config JELLYFRAME_ESP32S3_RGB565_GRADIENT_DITHER
    bool "Dither RGB565 presentation for pages containing gradients"
    depends on JELLYFRAME_ESP32S3_RUN_TIMER_UI_TASK || JELLYFRAME_ESP32S3_RUN_BAND_SHELL_UI_TASK || JELLYFRAME_ESP32S3_RUN_GRADIENT_FASTPATH_UI_TASK || JELLYFRAME_ESP32S3_RUN_SCROLL_BENCHMARK || JELLYFRAME_ESP32S3_RUN_APP_RUNTIME_RECOVERY_ACCEPTANCE
    default y
    help
        Uses the Render Core's deterministic 4x4 ordered RGB565 quantization
        only when the retained layer tree contains a linear, radial or conic
        gradient. It breaks up visible 16-bit color bands without changing
        RGBA rendering or adding work to pages without gradients. Disable for
        panel-specific A/B comparison or if a display controller already
        applies its own dithering.

config JELLYFRAME_ESP32S3_USE_PACKED_RGB565_SINK
    bool "Use direct packed RGB565 presentation sink"
    depends on JELLYFRAME_ESP32S3_RUN_TIMER_UI_TASK || JELLYFRAME_ESP32S3_RUN_BAND_SHELL_UI_TASK || JELLYFRAME_ESP32S3_RUN_GRADIENT_FASTPATH_UI_TASK || JELLYFRAME_ESP32S3_RUN_SCROLL_BENCHMARK || JELLYFRAME_ESP32S3_RUN_APP_RUNTIME_RECOVERY_ACCEPTANCE
    default n
    help
        Presents each dirty rectangle through EmbeddedPackedRgb565Sink. The
        default framebuffer sink remains the production path because the
        WS147 full-screen gradient A/B measured higher p95 latency for packed
        conversion. Enable only for a port-side comparison or a panel with
        independent evidence. Both paths retain the same RGBA-to-RGB565
        quantization.

config JELLYFRAME_ESP32S3_TIMER_UI_AUTOSTART
    bool "Start Timer UI in running state"
    depends on JELLYFRAME_ESP32S3_RUN_TIMER_UI_TASK
    default n
    help
        Test-only switch for retained-text performance captures. Production
        bring-up profiles keep this disabled so the Timer waits for a real
        pointer/touch event before running.

config JELLYFRAME_ESP32S3_SCROLL_BENCH_STEP_PIXELS
    int "Scroll benchmark step in pixels"
    depends on JELLYFRAME_ESP32S3_RUN_SCROLL_BENCHMARK
    default 6
    range 1 32
    help
        Vertical offset applied every 33 ms by the deterministic scroll workload.
        Keep it smaller than the visible scroll region for partial present data.

config JELLYFRAME_ESP32S3_SCROLL_AUTORUN
    bool "Automatically advance the scroll workload"
    depends on JELLYFRAME_ESP32S3_RUN_SCROLL_BENCHMARK
    default y
    help
        Keeps the deterministic benchmark moving at 30 Hz. Disable this for
        the interactive on-device demo; touch dragging remains enabled in
        either mode.

choice JELLYFRAME_ESP32S3_SCROLL_BENCH_WORKLOAD
    prompt "Retained scroll benchmark workload"
    depends on JELLYFRAME_ESP32S3_RUN_SCROLL_BENCHMARK
    default JELLYFRAME_ESP32S3_SCROLL_BENCH_WORKLOAD_FULL
    help
        Select one controlled workload at a time. All variants use the same
        visible scroll area, content extent and 30 Hz step policy, so their
        compose_ms_per_flush values can identify whether text, rounded cards
        or static background painting dominates the measured board cost.

config JELLYFRAME_ESP32S3_SCROLL_BENCH_WORKLOAD_FULL
    bool "Full list: text, rounded cards and background"

config JELLYFRAME_ESP32S3_SCROLL_BENCH_WORKLOAD_TEXT
    bool "Text-only list"

config JELLYFRAME_ESP32S3_SCROLL_BENCH_WORKLOAD_CARDS
    bool "Rounded-card-only list"

config JELLYFRAME_ESP32S3_SCROLL_BENCH_WORKLOAD_BACKGROUND
    bool "Background-only scroll extent"

config JELLYFRAME_ESP32S3_SCROLL_BENCH_WORKLOAD_CLEAR
    bool "Transparent clear-and-clip baseline"

config JELLYFRAME_ESP32S3_SCROLL_BENCH_WORKLOAD_PANEL
    bool "Full-screen opaque panel-scroll A/B fixture"
    help
        Uses one full screen-sized rectangular overflow viewport with no indicator,
        rounded corners, transparent pixels or overlapping UI. It is the only
        valid workload for an experimental board-local physical-GRAM scroll path.

endchoice

config JELLYFRAME_WS147_PANEL_SCROLL_ACCELERATION
    bool "Experimental WS147 physical-GRAM scroll A/B path"
    depends on JELLYFRAME_ESP32S3_RUN_SCROLL_BENCHMARK && JELLYFRAME_ESP32S3_SCROLL_BENCH_WORKLOAD_PANEL && JELLYFRAME_ESP32S3_BOARD_ENABLE_HARDWARE && JELLYFRAME_ESP32S3_BOARD_WAVESHARE_TOUCH_LCD_147
    default n
    help
        Experimental, disabled-by-default A/B path for the Waveshare 1.47
        JD9853 panel. Each eligible scroll step sends only the unique exposed
        full-width strip through the verified physical GRAM ring mapping.
        Any mixed dirty update, invalid viewport, callback error or panel
        uncertainty immediately resets the scroll address and falls back to
        the normal framebuffer scroll-blit present path.

config JELLYFRAME_WS147_PANEL_SCROLL_FALLBACK_PROBE
    bool "Inject one WS147 panel-scroll ineligible-frame fallback"
    depends on JELLYFRAME_WS147_PANEL_SCROLL_ACCELERATION
    default n
    help
        Acceptance-only probe. After 30 successful panel-scroll steps, forces
        one frame through the existing ineligible-frame recovery path. The
        path must reset VSCSAD, rebuild and present the full viewport, then
        re-enter panel scroll on the following eligible frame. Keep disabled
        in normal and production profiles.

config JELLYFRAME_WS169_PANEL_SCROLL_ACCELERATION
    bool "Experimental WS169 ST7789 physical-GRAM scroll A/B path"
    depends on JELLYFRAME_ESP32S3_RUN_SCROLL_BENCHMARK && JELLYFRAME_ESP32S3_SCROLL_BENCH_WORKLOAD_PANEL && JELLYFRAME_ESP32S3_BOARD_ENABLE_HARDWARE && JELLYFRAME_ESP32S3_BOARD_WAVESHARE_TOUCH_LCD_169
    default n
    help
        Experimental, disabled-by-default A/B path for the Waveshare 1.69
        ST7789V2 panel. It configures the controller's 20/280/20 physical
        GRAM scroll region and submits only the exposed strip. This is valid
        only for the dedicated full-screen opaque fixture. Any uncertainty
        resets VSCSAD and returns to normal presentation.

config JELLYFRAME_BENCH_CARD_COUNT
    int "Synthetic card count"
    default 40
    range 1 400
    help
        Number of synthetic card nodes generated for parser, style and layout
        benchmarks.

config JELLYFRAME_BENCH_ITERATIONS
    int "Benchmark iterations"
    default 20
    range 1 5000
    help
        Number of iterations used for each measured stage.

config JELLYFRAME_BENCH_VIEWPORT_WIDTH
    int "Viewport width"
    default 300
    range 64 800

config JELLYFRAME_BENCH_VIEWPORT_HEIGHT
    int "Viewport height"
    default 300
    range 64 800

config JELLYFRAME_BENCH_PRESENT_RGB565
    bool "Benchmark RGB565 framebuffer presentation"
    default y
    help
        Converts the rendered RGBA framebuffer into a host-owned RGB565 buffer
        through the embedded framebuffer HAL adapter.

endmenu

menu "JellyFrame ESP32-S3 board support"

config JELLYFRAME_ESP32S3_BOARD_ENABLE_HARDWARE
    bool "Enable physical board display/touch drivers"
    default n
    help
        Enables board-local hardware drivers. Keep this disabled for QEMU and
        generic benchmark runs.

choice JELLYFRAME_ESP32S3_BOARD
    prompt "Physical board profile"
    depends on JELLYFRAME_ESP32S3_BOARD_ENABLE_HARDWARE
    default JELLYFRAME_ESP32S3_BOARD_GENERIC

config JELLYFRAME_ESP32S3_BOARD_GENERIC
    bool "Generic/no physical panel"

config JELLYFRAME_ESP32S3_BOARD_WAVESHARE_TOUCH_LCD_147
    bool "Waveshare ESP32-S3-Touch-LCD-1.47"
    help
        Board-local adapter for the 172x320 JD9853 SPI LCD and AXS5106L I2C
        touch controller.

config JELLYFRAME_ESP32S3_BOARD_WAVESHARE_TOUCH_LCD_169
    bool "Waveshare ESP32-S3-Touch-LCD-1.69"
    help
        Board-local adapter for the 240x280 ST7789V2 SPI LCD and CST816T I2C
        touch controller.

endchoice

config JELLYFRAME_WS147_LCD_WIDTH
    int "Waveshare 1.47 LCD width"
    depends on JELLYFRAME_ESP32S3_BOARD_WAVESHARE_TOUCH_LCD_147
    default 172

config JELLYFRAME_WS147_LCD_HEIGHT
    int "Waveshare 1.47 LCD height"
    depends on JELLYFRAME_ESP32S3_BOARD_WAVESHARE_TOUCH_LCD_147
    default 320

config JELLYFRAME_WS147_LCD_SPI_SCLK_GPIO
    int "Waveshare 1.47 LCD SPI SCLK GPIO"
    depends on JELLYFRAME_ESP32S3_BOARD_WAVESHARE_TOUCH_LCD_147
    default 38

config JELLYFRAME_WS147_LCD_SPI_MOSI_GPIO
    int "Waveshare 1.47 LCD SPI MOSI GPIO"
    depends on JELLYFRAME_ESP32S3_BOARD_WAVESHARE_TOUCH_LCD_147
    default 39

config JELLYFRAME_WS147_LCD_CS_GPIO
    int "Waveshare 1.47 LCD CS GPIO"
    depends on JELLYFRAME_ESP32S3_BOARD_WAVESHARE_TOUCH_LCD_147
    default 21

config JELLYFRAME_WS147_LCD_DC_GPIO
    int "Waveshare 1.47 LCD DC GPIO"
    depends on JELLYFRAME_ESP32S3_BOARD_WAVESHARE_TOUCH_LCD_147
    default 45

config JELLYFRAME_WS147_LCD_RST_GPIO
    int "Waveshare 1.47 LCD reset GPIO"
    depends on JELLYFRAME_ESP32S3_BOARD_WAVESHARE_TOUCH_LCD_147
    default 40

config JELLYFRAME_WS147_LCD_BL_GPIO
    int "Waveshare 1.47 LCD backlight GPIO"
    depends on JELLYFRAME_ESP32S3_BOARD_WAVESHARE_TOUCH_LCD_147
    default 46

config JELLYFRAME_WS147_LCD_BL_ON_LEVEL
    int "Waveshare 1.47 LCD backlight active level"
    depends on JELLYFRAME_ESP32S3_BOARD_WAVESHARE_TOUCH_LCD_147
    default 1
    range 0 1

config JELLYFRAME_WS147_LCD_PIXEL_CLOCK_HZ
    int "Waveshare 1.47 LCD SPI pixel clock"
    depends on JELLYFRAME_ESP32S3_BOARD_WAVESHARE_TOUCH_LCD_147
    default 80000000

config JELLYFRAME_WS147_LCD_DMA_ROWS
    int "Waveshare 1.47 LCD DMA rows"
    depends on JELLYFRAME_ESP32S3_BOARD_WAVESHARE_TOUCH_LCD_147
    default 40
    range 1 320

config JELLYFRAME_WS147_LCD_SWAP_RGB565_BYTES
    bool "Swap RGB565 bytes before JD9853 SPI flush"
    depends on JELLYFRAME_ESP32S3_BOARD_WAVESHARE_TOUCH_LCD_147
    default y
    help
        JD9853 receives RGB565 over SPI in big-endian byte order. Enable this
        when colors look shifted or red/blue/green components appear wrong.

config JELLYFRAME_WS147_TOUCH_SDA_GPIO
    int "Waveshare 1.47 touch I2C SDA GPIO"
    depends on JELLYFRAME_ESP32S3_BOARD_WAVESHARE_TOUCH_LCD_147
    default 42

config JELLYFRAME_WS147_TOUCH_SCL_GPIO
    int "Waveshare 1.47 touch I2C SCL GPIO"
    depends on JELLYFRAME_ESP32S3_BOARD_WAVESHARE_TOUCH_LCD_147
    default 41

config JELLYFRAME_WS147_TOUCH_INT_GPIO
    int "Waveshare 1.47 touch INT GPIO"
    depends on JELLYFRAME_ESP32S3_BOARD_WAVESHARE_TOUCH_LCD_147
    default 48

config JELLYFRAME_WS147_TOUCH_RST_GPIO
    int "Waveshare 1.47 touch reset GPIO"
    depends on JELLYFRAME_ESP32S3_BOARD_WAVESHARE_TOUCH_LCD_147
    default 47

config JELLYFRAME_WS147_TOUCH_ADDR
    hex "Waveshare 1.47 AXS5106L I2C address"
    depends on JELLYFRAME_ESP32S3_BOARD_WAVESHARE_TOUCH_LCD_147
    default 0x63

config JELLYFRAME_WS169_LCD_WIDTH
    int "Waveshare 1.69 LCD width"
    depends on JELLYFRAME_ESP32S3_BOARD_WAVESHARE_TOUCH_LCD_169
    default 240

config JELLYFRAME_WS169_LCD_HEIGHT
    int "Waveshare 1.69 LCD height"
    depends on JELLYFRAME_ESP32S3_BOARD_WAVESHARE_TOUCH_LCD_169
    default 280

config JELLYFRAME_WS169_LCD_SPI_SCLK_GPIO
    int "Waveshare 1.69 LCD SPI SCLK GPIO"
    depends on JELLYFRAME_ESP32S3_BOARD_WAVESHARE_TOUCH_LCD_169
    default 6

config JELLYFRAME_WS169_LCD_SPI_MOSI_GPIO
    int "Waveshare 1.69 LCD SPI MOSI GPIO"
    depends on JELLYFRAME_ESP32S3_BOARD_WAVESHARE_TOUCH_LCD_169
    default 7

config JELLYFRAME_WS169_LCD_CS_GPIO
    int "Waveshare 1.69 LCD CS GPIO"
    depends on JELLYFRAME_ESP32S3_BOARD_WAVESHARE_TOUCH_LCD_169
    default 5

config JELLYFRAME_WS169_LCD_DC_GPIO
    int "Waveshare 1.69 LCD DC GPIO"
    depends on JELLYFRAME_ESP32S3_BOARD_WAVESHARE_TOUCH_LCD_169
    default 4

config JELLYFRAME_WS169_LCD_RST_GPIO
    int "Waveshare 1.69 LCD reset GPIO"
    depends on JELLYFRAME_ESP32S3_BOARD_WAVESHARE_TOUCH_LCD_169
    default 8

config JELLYFRAME_WS169_LCD_BL_GPIO
    int "Waveshare 1.69 LCD backlight GPIO"
    depends on JELLYFRAME_ESP32S3_BOARD_WAVESHARE_TOUCH_LCD_169
    default 15

config JELLYFRAME_WS169_LCD_PIXEL_CLOCK_HZ
    int "Waveshare 1.69 LCD SPI pixel clock"
    depends on JELLYFRAME_ESP32S3_BOARD_WAVESHARE_TOUCH_LCD_169
    default 40000000

config JELLYFRAME_WS169_LCD_DMA_ROWS
    int "Waveshare 1.69 LCD DMA rows"
    depends on JELLYFRAME_ESP32S3_BOARD_WAVESHARE_TOUCH_LCD_169
    default 40
    range 1 280

config JELLYFRAME_WS169_TOUCH_SDA_GPIO
    int "Waveshare 1.69 touch I2C SDA GPIO"
    depends on JELLYFRAME_ESP32S3_BOARD_WAVESHARE_TOUCH_LCD_169
    default 11

config JELLYFRAME_WS169_TOUCH_SCL_GPIO
    int "Waveshare 1.69 touch I2C SCL GPIO"
    depends on JELLYFRAME_ESP32S3_BOARD_WAVESHARE_TOUCH_LCD_169
    default 10

config JELLYFRAME_WS169_TOUCH_INT_GPIO
    int "Waveshare 1.69 touch INT GPIO"
    depends on JELLYFRAME_ESP32S3_BOARD_WAVESHARE_TOUCH_LCD_169
    default 14

config JELLYFRAME_WS169_TOUCH_RST_GPIO
    int "Waveshare 1.69 touch reset GPIO"
    depends on JELLYFRAME_ESP32S3_BOARD_WAVESHARE_TOUCH_LCD_169
    default 13

config JELLYFRAME_WS169_TOUCH_ADDR
    hex "Waveshare 1.69 CST816T I2C address"
    depends on JELLYFRAME_ESP32S3_BOARD_WAVESHARE_TOUCH_LCD_169
    default 0x15

endmenu
```
